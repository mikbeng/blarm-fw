## sdkconfig.defaults
```kconfig
# Set target to ESP32
CONFIG_IDF_TARGET="esp32c3"
CONFIG_IDF_TARGET_ESP32C3=y

CONFIG_RTC_CLK_SRC_EXT_CRYS=y
CONFIG_BOOTLOADER_SKIP_VALIDATE_IN_DEEP_SLEEP=y
#CONFIG_ESP_SLEEP_GPIO_ENABLE_INTERNAL_RESISTORS=n
```
